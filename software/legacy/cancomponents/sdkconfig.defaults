## software/legacy/cancomponents/sdkconfig.defaults
```kconfig
# Override some defaults to enable Arduino framework
CONFIG_ENABLE_ARDUINO_DEPENDS=y
CONFIG_AUTOSTART_ARDUINO=n
CONFIG_ARDUINO_RUN_CORE1=y
CONFIG_ARDUINO_RUNNING_CORE=1
CONFIG_ARDUINO_EVENT_RUN_CORE1=y
CONFIG_ARDUINO_EVENT_RUNNING_CORE=1
CONFIG_ARDUINO_UDP_RUN_CORE1=y
CONFIG_ARDUINO_UDP_RUNNING_CORE=1
CONFIG_DISABLE_HAL_LOCKS=y
CONFIG_ARDUHAL_LOG_DEFAULT_LEVEL_ERROR=y
CONFIG_ARDUHAL_LOG_DEFAULT_LEVEL=1
CONFIG_ARDUHAL_PARTITION_SCHEME_DEFAULT=n
CONFIG_ARDUHAL_PARTITION_SCHEME="partitions.csv"
CONFIG_AUTOCONNECT_WIFI=n
CONFIG_ARDUINO_SELECTIVE_WiFi=y
CONFIG_MBEDTLS_PSK_MODES=y
CONFIG_MBEDTLS_KEY_EXCHANGE_PSK=y
CONFIG_BT_ENABLED=n
CONFIG_WIFI_ENABLED=n
CONFIG_LWIP_ENABLED=n
CONFIG_MDNS_ENABLED=n
CONFIG_ESP_MESH_ENABLED=n
CONFIG_SMARTCONFIG_ENABLED=n
CONFIG_ESP_NOW_ENABLED=n
CONFIG_ETH_ENABLED=n
```
